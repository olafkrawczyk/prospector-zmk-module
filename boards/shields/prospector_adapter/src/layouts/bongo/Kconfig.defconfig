## boards/shields/prospector_adapter/src/layouts/bongo/Kconfig.defconfig
```kconfig
if PROSPECTOR_STATUS_SCREEN_BONGO

config ZMK_DISPLAY_STATUS_SCREEN_CUSTOM
    select LV_USE_LABEL
    select LV_USE_IMAGE

config ZMK_WPM
    default y

config LV_Z_MEM_POOL_SIZE
    default 20000

endif
```

## boards/shields/prospector_adapter/src/layouts/pomodoro/Kconfig.defconfig
```kconfig
if PROSPECTOR_SCREEN_POMODORO_ENABLED

config ZMK_DISPLAY_STATUS_SCREEN_CUSTOM
    select LV_USE_LABEL

endif
```

## dts/bindings/zmk,behavior-pomodoro.yaml
```yaml
# SPDX-License-Identifier: MIT

description: Pomodoro timer control behavior

compatible: "zmk,behavior-pomodoro"

include: zero_param.yaml

properties:
  action:
    type: int
    default: 0
    enum: [0, 1]
    description: |
      0 = start/stop toggle (begin the work phase, or stop and return to idle).
      1 = cycle the interval preset (25/5 <-> 50/10), idle only.
```
